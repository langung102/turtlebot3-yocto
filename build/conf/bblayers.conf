## build/conf/bblayers.conf
```bitbake
# POKY_BBLAYERS_CONF_VERSION is increased each time build/conf/bblayers.conf
# changes incompatibly
POKY_BBLAYERS_CONF_VERSION = "2"

BBPATH = "${TOPDIR}"
BBFILES ?= ""

BBLAYERS ?= " \
  ${TOPDIR}/../subrepos/poky/meta \
  ${TOPDIR}/../subrepos/poky/meta-poky \
  ${TOPDIR}/../subrepos/poky/meta-yocto-bsp \
  ${TOPDIR}/../subrepos/meta-ros/meta-ros2-humble \
  ${TOPDIR}/../subrepos/meta-ros/meta-ros-common \
  ${TOPDIR}/../subrepos/meta-ros/meta-ros2 \
  ${TOPDIR}/../subrepos/meta-openembedded/meta-networking \
  ${TOPDIR}/../subrepos/meta-openembedded/meta-oe \
  ${TOPDIR}/../subrepos/meta-openembedded/meta-filesystems \
  ${TOPDIR}/../subrepos/meta-openembedded/meta-python \
  ${TOPDIR}/../subrepos/meta-rockchip \
  ${TOPDIR}/../subrepos/meta-arm/meta-arm \
  ${TOPDIR}/../subrepos/meta-arm/meta-arm-toolchain \
  ${TOPDIR}/../subrepos/meta-qt5\
  ${TOPDIR}/../meta-tourguide \
  "
```

## meta-tourguide/conf/layer.conf
```bitbake
# define the ROS 2 Yocto target release
ROS_OE_RELEASE_SERIES = "nanbield"

# define ROS 2 distro
ROS_DISTRO = "humble"

# We have a conf and classes directory, add to BBPATH
BBPATH .= ":${LAYERDIR}"

# We have recipes-* directories, add to BBFILES
BBFILES += "${LAYERDIR}/recipes-*/*/*.bb \
            ${LAYERDIR}/recipes-*/*/*.bbappend"

BBFILE_COLLECTIONS += "meta-tourguide"
BBFILE_PATTERN_meta-tourguide= "^${LAYERDIR}/"
BBFILE_PRIORITY_meta-tourguide = "6"

LAYERDEPENDS_meta-tourguide = "core"
LAYERSERIES_COMPAT_meta-tourguide = "nanbield kirkstone"

DISTRO_FEATURES += " systemd usrmerge x11 opengl"
VIRTUAL-RUNTIME_init_manager = "systemd"
DISTRO_FEATURES_BACKFILL_CONSIDERED = "sysvinit"
VIRTUAL-RUNTIME_initscripts = ""
# VIRTUAL-RUNTIME_init_manager ?= "sysvinit"
# VIRTUAL-RUNTIME_initscripts ?= "initscripts"
```
